## kernel/Kconfig.oxscada
```kconfig
# SPDX-License-Identifier: GPL-2.0
#
# 0xSCADA Kernel Configuration
#
# Kconfig options for the 0xSCADA industrial blockchain-anchored SCADA kernel.
# These options control custom modules for event processing, cryptographic
# operations, L2 bridge synchronization, and real-time watchdog.
#

menuconfig OXSCADA
	tristate "0xSCADA Industrial Blockchain SCADA Support"
	depends on NET && CRYPTO
	help
	  Enable support for 0xSCADA industrial SCADA operations with
	  blockchain anchoring. This provides a kernel-space event processing
	  pipeline, HSM crypto integration, and L2 state synchronization.

	  If unsure, say N.

if OXSCADA

config OXSCADA_RT
	bool "Real-time optimizations for SCADA event processing"
	depends on PREEMPT_RT
	default y
	help
	  Enable real-time scheduling optimizations for the 0xSCADA event
	  pipeline. Requires PREEMPT_RT. Sets SCHED_FIFO for event worker
	  threads with configurable priority.

	  Target latency: < 50 µs on x86_64, < 100 µs on ARM64.

config OXSCADA_RT_PRIORITY
	int "Default RT priority for event threads (1-99)"
	depends on OXSCADA_RT
	range 1 99
	default 50
	help
	  Real-time scheduling priority for 0xSCADA event worker threads.
	  Higher values = higher priority. Default 50 balances SCADA needs
	  with system responsiveness.

# ---------------------------------------------------------------------------
# Event Subsystem
# ---------------------------------------------------------------------------

config OXSCADA_EVENT
	tristate "0xSCADA Event Subsystem"
	depends on OXSCADA
	select RELAY
	help
	  Lock-free kernel-space event ring buffer with publish/subscribe
	  semantics. Events are produced by SCADA sensors/actuators and
	  consumed by the anchoring pipeline.

	  Provides /proc/oxscada/events for monitoring and netlink interface
	  for userspace event injection.

config OXSCADA_EVENT_RING_SIZE
	int "Event ring buffer size (power of 2, in pages)"
	depends on OXSCADA_EVENT
	range 4 1024
	default 64
	help
	  Size of the per-CPU event ring buffer in pages. Must be a power
	  of 2. Larger buffers reduce the chance of event drops under load
	  but consume more memory.

	  64 pages = 256 KB per CPU (default).

config OXSCADA_EVENT_NETLINK
	bool "Netlink interface for userspace event injection"
	depends on OXSCADA_EVENT
	default y
	help
	  Allow userspace processes to inject events into the kernel event
	  pipeline via netlink sockets. Required for software-defined SCADA
	  sensors and simulation.

config OXSCADA_EVENT_TRACING
	bool "Event tracing via ftrace"
	depends on OXSCADA_EVENT && FTRACE
	default n
	help
	  Add ftrace tracepoints for event lifecycle (create, queue, process,
	  anchor). Useful for debugging but adds overhead.

# ---------------------------------------------------------------------------
# Crypto / HSM Integration
# ---------------------------------------------------------------------------

config OXSCADA_CRYPTO
	tristate "0xSCADA Crypto Subsystem"
	depends on OXSCADA
	select CRYPTO_SHA256
	select CRYPTO_HASH
	help
	  Kernel crypto API integration for 0xSCADA operations. Provides
	  Merkle tree computation, digital signatures, and HSM bridging
	  through the kernel crypto subsystem.

config OXSCADA_CRYPTO_HSM
	bool "HSM hardware bridge via PKCS#11"
	depends on OXSCADA_CRYPTO
	default y
	help
	  Bridge kernel crypto operations to hardware security modules
	  via PKCS#11 userspace helper. Keys never leave the HSM.

	  If disabled, falls back to software crypto (not recommended
	  for production).

config OXSCADA_CRYPTO_KECCAK
	bool "Keccak-256 support (Ethereum compatibility)"
	depends on OXSCADA_CRYPTO
	select CRYPTO_SHA3
	default y
	help
	  Enable Keccak-256 hashing for Ethereum-compatible Merkle trees
	  and address derivation. Required for L2 proof verification.

config OXSCADA_CRYPTO_MERKLE
	bool "In-kernel Merkle proof verification"
	depends on OXSCADA_CRYPTO
	default y
	help
	  O(log n) Merkle proof verification in kernel space. Supports
	  standard and sparse Merkle trees with proof compression and
	  batch verification.

config OXSCADA_CRYPTO_MERKLE_CACHE_SIZE
	int "Merkle node cache size (entries)"
	depends on OXSCADA_CRYPTO_MERKLE
	range 256 65536
	default 4096
	help
	  Number of intermediate Merkle nodes to cache. Larger caches
	  speed up repeated proof verification at the cost of memory.

# ---------------------------------------------------------------------------
# L2 Bridge
# ---------------------------------------------------------------------------

config OXSCADA_BRIDGE
	tristate "0xSCADA L2 Bridge Driver"
	depends on OXSCADA && OXSCADA_EVENT
	help
	  Bidirectional state synchronization between the kernel event
	  pipeline and Ethereum L2 networks. Handles event anchoring
	  (kernel→L2) and state root import (L2→kernel).

config OXSCADA_BRIDGE_BATCH_SIZE
	int "Maximum events per anchor batch"
	depends on OXSCADA_BRIDGE
	range 1 10000
	default 256
	help
	  Maximum number of events to include in a single L2 anchor
	  transaction. Larger batches amortize gas costs but increase
	  confirmation latency.

config OXSCADA_BRIDGE_FINALITY_BLOCKS
	int "L2 finality confirmation depth (blocks)"
	depends on OXSCADA_BRIDGE
	range 1 1000
	default 64
	help
	  Number of L2 blocks to wait before considering a state root
	  final. Higher values increase security but add latency.

# ---------------------------------------------------------------------------
# Watchdog
# ---------------------------------------------------------------------------

config OXSCADA_WATCHDOG
	tristate "0xSCADA SCADA Watchdog"
	depends on OXSCADA && WATCHDOG
	help
	  SCADA-specific watchdog with consensus health monitoring.
	  Triggers automatic failover when event processing stalls or
	  consensus is lost.

config OXSCADA_WATCHDOG_TIMEOUT
	int "Watchdog timeout (milliseconds)"
	depends on OXSCADA_WATCHDOG
	range 100 60000
	default 5000
	help
	  Time without a heartbeat before the watchdog triggers failover.
	  Shorter timeouts improve fault detection but may cause false
	  positives under heavy load.

# ---------------------------------------------------------------------------
# Debug
# ---------------------------------------------------------------------------

config OXSCADA_DEBUG
	bool "0xSCADA debug support"
	depends on OXSCADA && DEBUG_KERNEL
	help
	  Enable verbose debug logging, additional assertions, and
	  debugfs entries for all 0xSCADA subsystems.

	  Only enable for development. Adds significant overhead.

config OXSCADA_DEBUGFS
	bool "debugfs entries"
	depends on OXSCADA_DEBUG && DEBUG_FS
	default y
	help
	  Expose internal state via /sys/kernel/debug/oxscada/ including
	  event statistics, crypto operation counters, bridge sync status,
	  and Merkle cache hit rates.

endif # OXSCADA
```

## linux-fork/0xscada/Kconfig
```kconfig
# SPDX-License-Identifier: GPL-2.0-only
#
# 0xSCADA Industrial Reality Capture Configuration
#

menuconfig SCADA_0X
	tristate "0xSCADA Industrial Reality Capture"
	depends on TRACING
	help
	  This option enables the 0xSCADA industrial reality capture
	  subsystem. It provides infrastructure for capturing, verifying,
	  and versioning industrial control system events as cryptographic
	  artifacts.

	  The 0xSCADA module captures:
	  - Kernel execution traces (ftrace integration)
	  - Industrial protocol transactions (Modbus, DNP3, IEC 61850)
	  - Hardware I/O events
	  - Agent decision points

	  If unsure, say N.

if SCADA_0X

config SCADA_0X_CORE
	tristate "0xSCADA Core Artifact Infrastructure"
	default y
	help
	  Core infrastructure for artifact capture, hashing, and storage.
	  This is required for all other 0xSCADA components.

config SCADA_0X_TRACE
	tristate "0xSCADA Trace Hooks"
	depends on SCADA_0X_CORE
	depends on FTRACE
	default y
	help
	  SCADA-specific ftrace hooks for capturing industrial control
	  events. Integrates with the kernel tracing infrastructure to
	  produce reality artifacts.

config SCADA_0X_NET
	tristate "0xSCADA Network Protocol Filtering"
	depends on SCADA_0X_CORE
	depends on NETFILTER
	default y
	help
	  Network filtering for industrial protocols. Captures and
	  creates artifacts for:
	  - Modbus TCP/RTU transactions
	  - DNP3 communications
	  - IEC 61850 GOOSE/MMS messages
	  - OPC UA sessions

config SCADA_0X_EBPF
	tristate "0xSCADA eBPF Integration"
	depends on SCADA_0X_CORE
	depends on BPF_SYSCALL
	default y
	help
	  eBPF-based artifact capture for high-performance tracing.
	  Allows user-space definition of capture points with kernel
	  performance.

config SCADA_0X_CRYPTO
	tristate "0xSCADA Cryptographic Verification"
	depends on SCADA_0X_CORE
	depends on CRYPTO_SHA256
	default y
	help
	  Cryptographic hashing and verification for artifacts.
	  Implements content-addressed storage and chain validation.

config SCADA_0X_DEBUG
	bool "0xSCADA Debug Output"
	depends on SCADA_0X_CORE
	default n
	help
	  Enable verbose debug output for 0xSCADA subsystem.
	  This produces significant log volume and should only
	  be enabled for development.

endif # SCADA_0X
```

## linux-fork/0xscada/trace-capture/tests/kunit/Kconfig
```kconfig
config SCADA_TRACE_TEST
	tristate "0xSCADA trace capture KUnit tests"
	depends on KUNIT
	depends on SCADA_TRACE
	help
	  KUnit tests for the 0xSCADA kernel trace capture module.
	  
	  If unsure, say N.
```
